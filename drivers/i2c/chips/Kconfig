## drivers/i2c/chips/Kconfig
```kconfig
#
# Miscellaneous I2C chip drivers configuration
#
# *** DEPRECATED! Do not add new entries! See Makefile ***
#

menu "Miscellaneous I2C Chip support"

config DS1682
	tristate "Dallas DS1682 Total Elapsed Time Recorder with Alarm"
	depends on EXPERIMENTAL
	help
	  If you say yes here you get support for Dallas Semiconductor
	  DS1682 Total Elapsed Time Recorder.

	  This driver can also be built as a module.  If so, the module
	  will be called ds1682.

config TWL4030_POWEROFF
        bool "TWL4030 device poweroff"
        depends on TWL4030_CORE

config TWL4030_AUDIO_TEST
	tristate "TWL4030 audio device test driver"
	depends on TWL4030_CORE

config SENSORS_TSL2550
	tristate "Taos TSL2550 ambient light sensor"
	depends on EXPERIMENTAL
	help
	  If you say yes here you get support for the Taos TSL2550
	  ambient light sensor.

	  This driver can also be built as a module.  If so, the module
	  will be called tsl2550.

config SENSORS_PCA963X
	tristate "Philips PCA963X 4-bit I2C-bus LED"
	depends on I2C && EXPERIMENTAL
	help
	 If you say yes here you get support for the Philips PCA963X
	 4-bit I2C-bus LED.

	 This driver can also be built as a module.  If so, the module
	 will be called pca963X.

config SOUND_FM2018
	tristate "FM2018 Sound Echo Cancellation Driver"
	depends on TWL4030_CORE

config SOUND_ALC108
	tristate "ALC108 Sound Headphone & Speaker Amplifier Driver"
	depends on TWL4030_CORE

config SOUND_WM9093
	tristate "WM9093 Sound Headphone & Speaker Amplifier Driver"
	depends on TWL4030_CORE

config SOUND_TLV320AIC3204
	tristate "TLV320AIC3204 Sound ADC & DAC Driver"
	depends on TWL4030_CORE

config TWL4030_MADC
	tristate "TWL4030 MADC Driver"
	depends on TWL4030_CORE
	help
	The TWL4030 Monitoring ADC driver enables the host
	processor to monitor analog signals using analog-to-digital
	conversions on the input source. TWL4030 MADC provides the
	following features:
	 - Single 10-bit ADC with successive approximation register (SAR) conversion;
	 - Analog multiplexer for 16 inputs;
	 - Seven (of the 16) inputs are freely available;
	 - Battery voltage monitoring;
	 - Concurrent conversion request management;
	 - Interrupt signal to Primary Interrupt Handler;
	 - Averaging feature;
	 - Selective enable/disable of the averaging feature.

	Say 'y' here to statically link this module into the kernel or 'm'
	to build it as a dinamically loadable module. The module will be
	called twl4030-madc.ko

endmenu
```
